/*
 * Copyright (C) 2018 Icenowy Zheng <icenowy@aosc.io>
 *
 * SPDX-License-Identifier: (GPL-2.0+ OR X11)
 */

 #include "sun8i-v3s-licheepi-zero-with-lcd.dtsi"

 &panel {
	compatible = "atk,atk7_inch_1024x600", "simple-panel";
};
